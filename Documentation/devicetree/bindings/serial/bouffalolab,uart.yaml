## Documentation/devicetree/bindings/serial/bouffalolab,uart.yaml
```yaml
# SPDX-License-Identifier: (GPL-2.0-only OR BSD-2-Clause)
# Copyright (C) 2022 Jisheng Zhang <jszhang@kernel.org>
%YAML 1.2
---
$id: "http://devicetree.org/schemas/serial/bouffalolab,uart.yaml#"
$schema: "http://devicetree.org/meta-schemas/core.yaml#"

title: Bouffalolab UART Controller

maintainers:
  - Jisheng Zhang <jszhang@kernel.org>

allOf:
  - $ref: serial.yaml#

properties:
  compatible:
    const: bouffalolab,uart

  reg:
    maxItems: 1

  interrupts:
    maxItems: 1

  clocks:
    maxItems: 1

required:
  - compatible
  - reg
  - interrupts
  - clocks

additionalProperties: false

examples:
  - |
    #include <dt-bindings/interrupt-controller/irq.h>
    aliases {
        serial0 = &uart0;
    };

    uart0: serial@30002000 {
        compatible = "bouffalolab,uart";
        reg = <0x30002000 0x1000>;
        interrupts = <53 IRQ_TYPE_LEVEL_HIGH>;
        clocks = <&xtal>;
    };
...
```
